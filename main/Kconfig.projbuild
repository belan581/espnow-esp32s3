## main/Kconfig.projbuild
```kconfig
menu "Example Configuration"

    choice DEVICE_ROLE
        prompt "Device Role"
        default DEVICE_ROLE_MASTER
        help
            Select whether this device is a Master or Slave.

        config DEVICE_ROLE_MASTER
            bool "Master"
        config DEVICE_ROLE_SLAVE
            bool "Slave"
    endchoice

    config GPIO_PAIRING_BUTTON
        int "Pairing Button GPIO (Slave only)"
        default 1
        depends on DEVICE_ROLE_SLAVE
        help
            GPIO number for the pairing button on the slave device.
            Long press to pair with nearby master or unpair from current master.

    config GPIO_CONTROL_BUTTON
        int "Control Button GPIO (Master only)"
        default 7
        depends on DEVICE_ROLE_MASTER
        help
            GPIO number for the LED control button on the master device.

    config GPIO_LED_RGB
        int "RGB LED GPIO"
        default 48
        help
            GPIO number for the WS2812B RGB LED data line.

    config PAIRING_RSSI_THRESHOLD
        int "Pairing RSSI Threshold (dBm)"
        default -50
        range -100 0
        help
            Minimum RSSI value for pairing. Typical values:
            -30 dBm: ~1-2cm (touching), -50 dBm: ~4-10cm, -60 dBm: ~20-30cm
            More negative values allow greater distance.

    config PAIRING_LONG_PRESS_TIME
        int "Pairing Long Press Time (ms)"
        default 3000
        range 1000 10000
        depends on DEVICE_ROLE_SLAVE
        help
            Time in milliseconds to hold the pairing button for pairing/unpairing to initiate.

    config PAIRING_CONFIRMATION_DURATION
        int "Pairing Confirmation LED Duration (ms)"
        default 5000
        range 1000 30000
        help
            Duration in milliseconds for LED blink confirmation after successful pairing.

    choice ESPNOW_WIFI_MODE
        prompt "WiFi mode"
        default ESPNOW_WIFI_MODE_STATION
        help
            WiFi mode(station or softap).

        config ESPNOW_WIFI_MODE_STATION
            bool "Station"
        config ESPNOW_WIFI_MODE_STATION_SOFTAP
            bool "Softap"
    endchoice

    config ESPNOW_PMK
        string "ESPNOW primary master key"
        default "pmk1234567890123"
        help
            ESPNOW primary master for the example to use. The length of ESPNOW primary master must be 16 bytes.

    config ESPNOW_LMK
        string "ESPNOW local master key"
        default "lmk1234567890123"
        help
            ESPNOW local master for the example to use. The length of ESPNOW local master must be 16 bytes.

    config ESPNOW_CHANNEL
        int "Channel"
        default 1
        range 0 14
        help
            The channel on which sending and receiving ESPNOW data.

    config ESPNOW_SEND_COUNT
        int "Send count"
        default 100
        range 1 65535
        help
            Total count of unicast ESPNOW data to be sent.

    config ESPNOW_SEND_DELAY
        int "Send delay"
        default 1000
        range 0 65535
        help
            Delay between sending two ESPNOW data, unit: ms.

    config ESPNOW_SEND_LEN
        int "Send len"
        range 10 1470
        default 10
        help
            Length of ESPNOW data to be sent, unit: byte.

    config ESPNOW_ENABLE_LONG_RANGE
        bool "Enable Long Range"
        default "n"
        help
            When enable long range, the PHY rate of ESP32 will be 512Kbps or 256Kbps

    config ESPNOW_ENABLE_POWER_SAVE
        bool "Enable ESPNOW Power Save"
        default "n"
        select ESP_WIFI_STA_DISCONNECTED_PM_ENABLE
        depends on ESPNOW_WIFI_MODE_STATION
        help
            With ESPNOW power save enabled, chip would be able to wakeup and sleep periodically
            Notice ESP_WIFI_STA_DISCONNECTED_PM_ENABLE is essential at Wi-Fi disconnected

    config ESPNOW_WAKE_WINDOW
        int "ESPNOW wake window, unit in millisecond"
        range 0 65535
        default 50
        depends on ESPNOW_ENABLE_POWER_SAVE
        help
            ESPNOW wake window

    config ESPNOW_WAKE_INTERVAL
        int "ESPNOW wake interval, unit in millisecond"
        range 1 65535
        default 100
        depends on ESPNOW_ENABLE_POWER_SAVE
        help
            ESPNOW wake interval

endmenu
```
